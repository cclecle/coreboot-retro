## src/mainboard/ibm/PC300_6275/Kconfig
```kconfig
## SPDX-License-Identifier: GPL-2.0-only

if BOARD_IBM_PC300_6275

config BASE_PC300_6275
	def_bool n
	select HAVE_MP_TABLE

config BOARD_SPECIFIC_OPTIONS
	def_bool y
	select ACPI_NO_CUSTOM_MADT
	select CPU_INTEL_SLOT_1
	select NORTHBRIDGE_INTEL_I440BX
	select SOUTHBRIDGE_INTEL_I82371EB
	select SUPERIO_SMSC_SMSCSUPERIO
	select HAVE_PIRQ_TABLE
	select HAVE_OPTION_TABLE
	select BOARD_ROMSIZE_KB_256
	select USE_OPTION_TABLE
	select HAVE_ACPI_TABLES



config MAX_CPUS
	int
	default 1

config MAINBOARD_DIR
	default "ibm/PC300_6275"

config MAINBOARD_PART_NUMBER
	default "6275"

config IRQ_SLOT_COUNT
	int
	default 9

config PAYLOAD_CONFIGFILE
	string
	depends on PAYLOAD_BUILD_SEABIOS
	default "\$(top)/src/mainboard/\$(MAINBOARDDIR)/config_seabios" if PAYLOAD_BUILD_SEABIOS

config SEABIOS_BOOTORDER_FILE
	string
	depends on PAYLOAD_BUILD_SEABIOS
	default "\$(top)/src/mainboard/\$(MAINBOARDDIR)/bootorder" if PAYLOAD_BUILD_SEABIOS

config SEABIOS_REVISION
	bool
	depends on PAYLOAD_BUILD_SEABIOS
	select y

config SEABIOS_REVISION_ID
	string
	depends on PAYLOAD_BUILD_SEABIOS
	default "origin/work_300GL"

config SEABIOS_PS2_TIMEOUT
	int
	default 5000

config SEABIOS_DEBUG_LEVEL
	int
	depends on PAYLOAD_BUILD_SEABIOS
	default 7
endif
```
